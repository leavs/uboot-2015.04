## board/chipsee/mx6uleisd/Kconfig
```kconfig
if TARGET_MX6ULEISD

config SYS_BOARD
	default "mx6uleisd"

config SYS_VENDOR
	default "chipsee"

config SYS_SOC
	default "mx6"

config SYS_CONFIG_NAME
	default "mx6uleisd"

endif
```

## configs/mx6qsabresd_defconfig
```kconfig
CONFIG_SYS_EXTRA_OPTIONS="IMX_CONFIG=board/freescale/mx6sabresd/mx6q_8x_mt41K256.cfg,MX6Q,SYS_USE_SPINOR"
CONFIG_ARM=y
CONFIG_TARGET_MX6SABRESD=y
CONFIG_DM=y
CONFIG_DM_THERMAL=y
```

## configs/mx6uleisd_defconfig
```kconfig
CONFIG_SYS_EXTRA_OPTIONS="IMX_CONFIG=board/chipsee/mx6uleisd/mx6ul_16x_mt41k256.cfg,MX6UL,DRAM_SIZE=512"
CONFIG_ARM=y
CONFIG_TARGET_MX6ULEISD=y
CONFIG_SYS_MALLOC_F=y
CONFIG_SYS_MALLOC_F_LEN=0x400
CONFIG_DM=y
CONFIG_DM_THERMAL=y
```
